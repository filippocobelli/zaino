## firmware/main/Kconfig.projbuild
```kconfig
menu "Zaino"
    config ZAINO_SERVER_URL
        string "URL del server Zaino (es. http://192.168.1.50:3021)"
        default "http://192.168.1.100:3021"
    config ZAINO_BUTTON_PAGE_SECONDS
        int "Secondi prima di tornare alla pagina automatica dopo un tasto (se il server non lo indica)"
        default 180
    config ZAINO_RETRY_SECONDS
        int "Secondi prima di riprovare se Wi-Fi o server non rispondono"
        default 900
    config ZAINO_MAX_SLEEP_SECONDS
        int "Sonno massimo in un colpo (l'orologio interno deriva: meglio risvegli brevi)"
        default 3600
endmenu
```

## firmware/sdkconfig.defaults
```kconfig
CONFIG_IDF_TARGET="esp32s3"
CONFIG_ESPTOOLPY_FLASHSIZE_16MB=y
CONFIG_PARTITION_TABLE_CUSTOM=y
CONFIG_PARTITION_TABLE_CUSTOM_FILENAME="partitions.csv"
CONFIG_ESP_CONSOLE_USB_SERIAL_JTAG=y
CONFIG_ESP_DEFAULT_CPU_FREQ_MHZ_160=y
CONFIG_BOOTLOADER_SKIP_VALIDATE_IN_DEEP_SLEEP=y
CONFIG_BOOTLOADER_LOG_LEVEL_WARN=y
CONFIG_LOG_DEFAULT_LEVEL_INFO=y
CONFIG_ESP_HTTP_CLIENT_ENABLE_HTTPS=n
CONFIG_ESP_TASK_WDT_TIMEOUT_S=60
```
